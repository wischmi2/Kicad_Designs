## soil_moisture_fw/boards/others/soil_moisture/Kconfig.soil_moisture
```kconfig
config BOARD_SOIL_MOISTURE
	select SOC_NRF54L15_CPUAPP if BOARD_SOIL_MOISTURE_NRF54L15_CPUAPP
```

## soil_moisture_fw/boards/others/soil_moisture/board.yml
```yaml
board:
  name: soil_moisture
  full_name: nRF54L15 Soil Moisture
  vendor: others
  socs:
    - name: nrf54l15
runners:
  run_once:
    '--recover':
      - runners:
          - nrfjprog
          - nrfutil
        run: first
        groups:
          - boards:
              - soil_moisture/nrf54l15/cpuapp
    '--erase':
      - runners:
          - nrfjprog
          - jlink
          - nrfutil
        run: first
        groups:
          - boards:
              - soil_moisture/nrf54l15/cpuapp
    '--reset':
      - runners:
          - nrfjprog
          - jlink
          - nrfutil
        run: last
        groups:
          - boards:
              - soil_moisture/nrf54l15/cpuapp
```

## soil_moisture_fw/boards/others/soil_moisture/soil_moisture_nrf54l15_cpuapp_defconfig
```kconfig
CONFIG_ARM_MPU=y
CONFIG_HW_STACK_PROTECTION=y
CONFIG_GPIO=y
CONFIG_SERIAL=y
CONFIG_CONSOLE=y
CONFIG_UART_CONSOLE=n
CONFIG_USE_SEGGER_RTT=y
CONFIG_RTT_CONSOLE=y
CONFIG_LOG=y
CONFIG_LOG_BACKEND_RTT=y
CONFIG_I2C=y
CONFIG_MFD=y
CONFIG_REGULATOR=y
CONFIG_SENSOR=y
```
