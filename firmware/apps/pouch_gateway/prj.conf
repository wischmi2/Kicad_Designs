## CMakeLists.txt
```
# Pouch gateway for the Pouch gateway board (Murata Type 2FR, NXP RW612).
# Based on golioth/pouch examples/zephyr/gateway at 32ded9b (Copyright (c) 2025 Golioth, Inc.,
# Apache-2.0). Differences: builds out of this repo, firmware\ is added to BOARD_ROOT, the
# git_describe.h step no longer runs a .sh script (that hangs the build on Windows), the CA
# certificate is taken from the Pouch checkout instead of being copied here.
# SPDX-License-Identifier: Apache-2.0

cmake_minimum_required(VERSION 3.20.0)

# BOARD_ROOT = firmware (board definitions in firmware/boards/)
get_filename_component(FW_ROOT ${CMAKE_CURRENT_SOURCE_DIR}/../.. ABSOLUTE)
list(APPEND BOARD_ROOT ${FW_ROOT})

find_package(Zephyr REQUIRED HINTS $ENV{ZEPHYR_BASE})
project(pouch_gateway)

target_sources(app PRIVATE
  src/credentials.c
  src/fatal_error.c
  src/fw_update.c
  src/main.c
)

if(CONFIG_WIFI)
  target_sources(app PRIVATE src/wifi.c)
endif()

# GIT_DESCRIBE = describe of this repo at configure time
execute_process(COMMAND git describe --always --dirty
  WORKING_DIRECTORY ${CMAKE_CURRENT_LIST_DIR}
  OUTPUT_VARIABLE GW_GIT_DESCRIBE
  OUTPUT_STRIP_TRAILING_WHITESPACE
  ERROR_QUIET)
if(NOT GW_GIT_DESCRIBE)
  set(GW_GIT_DESCRIBE "unknown")
endif()
file(WRITE ${CMAKE_CURRENT_BINARY_DIR}/git_describe.h
  "#define GIT_DESCRIBE ${GW_GIT_DESCRIBE}\n")
target_include_directories(app PRIVATE ${CMAKE_CURRENT_BINARY_DIR})

if (NOT CONFIG_EXAMPLE_COAP_CLIENT_DTLS_LOAD_CA_FROM_FILESYSTEM)
  # ISRG Root X1 (public CA certificate) from the Pouch checkout
  generate_inc_file_for_target(app
    ${ZEPHYR_POUCH_MODULE_DIR}/examples/zephyr/http_client/src/isrgrootx1.der
    ${ZEPHYR_BINARY_DIR}/include/generated/pouch-ca-crt.inc)
endif()
```

## Kconfig
```
# Copyright (c) 2025 Golioth, Inc.
# SPDX-License-Identifier: Apache-2.0

configdefault NET_SHELL
	default n

configdefault MBEDTLS_HEAP_SIZE
	default 16384

configdefault BT_CTLR_DATA_LENGTH_MAX
	default 251

# This option is used only for automated tests
config SAMPLE_POUCH_GATEWAY_BT_AUTO_BOND
	bool
	default y if BOARD_NRF52_BSIM_NATIVE
	default y if BOARD_NRF9160DK_NRF52840

# This option is used only for automated tests
config SAMPLE_POUCH_GATEWAY_BT_AUTO_CONFIRM
	bool
	default y if BOARD_NRF52_BSIM_NATIVE
	default y if BOARD_NRF9160DK_NRF52840

config EXAMPLE_COAP_CLIENT_SYNC_PERIOD_S
	int "CoAP client sync period (s)"
	default 30

config EXAMPLE_CREDENTIALS_DIR
	string "Directory containing credentials"
	default "/lfs1/credentials"
	help
	  Directory on mounted file system containing credentials.

config EXAMPLE_COAP_CLIENT_DTLS_CREDENTIALS
	int "Sec Tag to use when storing DTLS credentials"
	default 515765868

config EXAMPLE_COAP_CLIENT_DTLS_LOAD_CA_FROM_FILESYSTEM
	bool "Load the server CA cert from filesystem"
	help
	  Optionally load the CA certificate used for DTLS/mTLS from
	  EXAMPLE_CREDENTIALS_DIR/ca.der. If this symbol is not selected,
	  ISRG Root X1 is used.

config EXAMPLE_COAP_CLIENT_GW_DEVICE_CRT_FILENAME
	string "Gateway device crt filename in filesystem"
	default "crt.der"
	help
	  The filename used to store the mTLS device certificate in the filesystem.

config EXAMPLE_COAP_CLIENT_GW_DEVICE_KEY_FILENAME
	string "Gateway device key filename in filesystem"
	default "key.der"
	help
	  The filename used to store the mTLS device private key in the filesystem.

config EXAMPLE_FW_UPDATE_COMPONENT
	string "OTA component (Golioth package name) for the gateway firmware"
	default "gateway"
	help
	  Name of the Golioth package that carries this firmware. Must match the package
	  created in the Golioth console (at most CONFIG_GOLIOTH_OTA_MAX_PACKAGE_NAME_LEN chars).

source "Kconfig.zephyr"
```

## sysbuild.conf
```
# MCUboot (Zephyr port) through sysbuild. Mode: Zephyr's default, swap using offset
# (no scratch partition; image-0 / image-1 in the board file are 3 MB each).
# Signed with the MCUboot debug key until a production key is chosen (CMake warns about it).
SB_CONFIG_BOOTLOADER_MCUBOOT=y
```

## prj.conf
```kconfig
CONFIG_POUCH=y
CONFIG_POUCH_GATEWAY=y
CONFIG_POUCH_TRANSPORT_COAP_CLIENT=y
CONFIG_GOLIOTH=y
CONFIG_GOLIOTH_SETTINGS=y
CONFIG_GOLIOTH_OTA=y

CONFIG_BT=y
CONFIG_BT_CENTRAL=y
CONFIG_BT_MAX_CONN=16
CONFIG_BT_GATT_CLIENT=y
CONFIG_BT_GATT_CACHING=n
CONFIG_BT_GATT_AUTO_UPDATE_MTU=y
CONFIG_BT_L2CAP_TX_MTU=247
CONFIG_BT_BUF_ACL_TX_SIZE=251
CONFIG_BT_BUF_ACL_RX_SIZE=251
CONFIG_BT_RX_STACK_SIZE=4096

CONFIG_COAP_INIT_ACK_TIMEOUT_MS=3000

CONFIG_LOG=y

# Settings subsystem
CONFIG_FLASH=y
CONFIG_FLASH_MAP=y

CONFIG_SETTINGS=y
CONFIG_SETTINGS_FILE=y
CONFIG_SETTINGS_FILE_PATH="/lfs1/settings"

# Application
CONFIG_MAIN_STACK_SIZE=8192
CONFIG_SYSTEM_WORKQUEUE_STACK_SIZE=2048
CONFIG_SHELL=y

CONFIG_ZVFS_EVENTFD_MAX=11

# Pouch server certificate parse
CONFIG_MBEDTLS_PSA_CRYPTO_C=y
CONFIG_MBEDTLS_PEM_PARSE_C=y
CONFIG_PSA_WANT_ALG_ECDSA=y
CONFIG_PSA_WANT_ALG_SHA_384=y
CONFIG_PSA_WANT_ECC_SECP_R1_256=y
CONFIG_PSA_WANT_ECC_SECP_R1_384=y
CONFIG_PSA_WANT_KEY_TYPE_ECC_PUBLIC_KEY=y

# Bluetooth secure connections
CONFIG_BT_SMP=y
CONFIG_BT_SECURITY_ERR_TO_STR=y
# This option is implied by BT_SMP and breaks secp384r1 support
CONFIG_MBEDTLS_PSA_P256M_DRIVER_ENABLED=n

# Networking
CONFIG_NETWORKING=y
CONFIG_NET_IPV4=y
CONFIG_NET_IPV6=n
CONFIG_NET_UDP=y
CONFIG_DNS_RESOLVER=y
CONFIG_NET_SOCKETS_CONNECT_TIMEOUT=6000
CONFIG_NET_SOCKETS_SOCKOPT_TLS=y
CONFIG_NET_SOCKETS_ENABLE_DTLS=y

# Sockets
CONFIG_NET_SOCKETS=y
CONFIG_ZVFS_POLL_MAX=4
CONFIG_POSIX_API=y

# Network driver config
CONFIG_TEST_RANDOM_GENERATOR=y

# Network buffers
CONFIG_NET_PKT_RX_COUNT=8
CONFIG_NET_PKT_TX_COUNT=8
CONFIG_NET_CONTEXT_NET_PKT_POOL=y

# Network address config
CONFIG_NET_CONFIG_SETTINGS=y
CONFIG_NET_CONFIG_NEED_IPV4=y
CONFIG_NET_CONFIG_NEED_IPV6=n

# CoAP
CONFIG_COAP=y

# File system for credentials
CONFIG_FILE_SYSTEM=y
CONFIG_FILE_SYSTEM_LITTLEFS=y
CONFIG_FILE_SYSTEM_SHELL=y

# Flash for LittleFS and the OTA image writer (image goes to image-1 through flash_img)
CONFIG_STREAM_FLASH=y
CONFIG_IMG_MANAGER=y
CONFIG_IMG_ERASE_PROGRESSIVELY=y

# TLS/DTLS configuration
CONFIG_MBEDTLS=y
CONFIG_MBEDTLS_BUILTIN=y
CONFIG_MBEDTLS_ENABLE_HEAP=y
CONFIG_MBEDTLS_HEAP_SIZE=60000
CONFIG_MBEDTLS_SSL_MAX_CONTENT_LEN=16384
CONFIG_MBEDTLS_SSL_PROTO_TLS1_2=y
CONFIG_MBEDTLS_X509_CRT_PARSE_C=y
CONFIG_MBEDTLS_KEY_EXCHANGE_ECDHE_ECDSA_ENABLED=y

# TLS cipher suites (via PSA Crypto)
CONFIG_PSA_WANT_ALG_ECDH=y
CONFIG_PSA_WANT_ALG_ECDSA=y
CONFIG_PSA_WANT_ALG_GCM=y
CONFIG_PSA_WANT_ALG_RSA_PKCS1V15_SIGN=y
CONFIG_PSA_WANT_ALG_SHA_256=y
CONFIG_PSA_WANT_ALG_TLS12_PRF=y
CONFIG_PSA_WANT_KEY_TYPE_AES=y
CONFIG_PSA_WANT_KEY_TYPE_ECC_KEY_PAIR_GENERATE=y
CONFIG_PSA_WANT_KEY_TYPE_RSA_PUBLIC_KEY=y
CONFIG_PSA_WANT_KEY_TYPE_RSA_KEY_PAIR_IMPORT=y

# Misc
CONFIG_REBOOT=y

# The shared pouch_buf pool backs both device-side pouch transfers
# and gateway downlink buffering.  Each slot must fit one CoAP block
# (CONFIG_POUCH_COAP_BLOCK_SIZE, default 1024) plus the protocol
# header overhead.  The count covers POUCH_GATEWAY_NUM_BLOCKS in-flight
# downlink blocks (default 10) plus headroom for the gateway's own
# device-side uplink/downlink.
CONFIG_POUCH_BLOCK_SIZE=1024
CONFIG_POUCH_BLOCK_COUNT=12

# Server cert buffers (Golioth's server cert is ~1.5 KB)
CONFIG_POUCH_SERVER_CERT_MAX_LEN=2048
CONFIG_POUCH_GATEWAY_SERVER_CERT_MAX_LEN=2048

# Enable mcumgr
CONFIG_ZCBOR=y
CONFIG_MCUMGR=y

# Enable the shell mcumgr transport. This allows SMP messages to pass
# through the shell to the mgmt subsystem.
CONFIG_BASE64=y
CONFIG_CRC=y
CONFIG_MCUMGR_TRANSPORT_SHELL=y

# Enable mcumgr params to allow smpmgr to query device for its MTU
CONFIG_MCUMGR_GRP_OS=y
CONFIG_MCUMGR_GRP_OS_MCUMGR_PARAMS=y

# Enable file system commands
CONFIG_MCUMGR_GRP_FS=y
CONFIG_MCUMGR_GRP_FS_FILE_ACCESS_HOOK=y
CONFIG_MCUMGR_MGMT_NOTIFICATION_HOOKS=y
```

## boards/pouch_gateway.conf
```kconfig
# Pouch gateway board (Murata Type 2FR, RW612), Wi-Fi only.
# Merged from golioth/pouch examples/zephyr/gateway boards/frdm_rw612.conf and
# boards/frdm_rw612_wifi.conf at 32ded9b (Copyright (c) 2025 Golioth, Inc., Apache-2.0).

CONFIG_NET_DHCPV4=y
CONFIG_BUILD_OUTPUT_HEX=y

CONFIG_MCUMGR_TRANSPORT_WORKQUEUE_STACK_SIZE=4096

CONFIG_WIFI=y
CONFIG_WIFI_NXP=y

# Ensure that filesystem initializes before settings
CONFIG_FILE_SYSTEM_INIT_PRIORITY=89

# Runtime provisioning for WiFi credentials
CONFIG_WIFI_CREDENTIALS=y
CONFIG_NET_L2_WIFI_SHELL=y
CONFIG_SHELL_STACK_SIZE=2560

# Wifi Configuration
CONFIG_NET_L2_ETHERNET=y
CONFIG_NET_PKT_RX_COUNT=36
CONFIG_NET_PKT_TX_COUNT=36
CONFIG_NET_BUF_RX_COUNT=40
CONFIG_NET_BUF_TX_COUNT=40
CONFIG_NET_BUF_DATA_SIZE=1744

# Handle WiFi Networks with Multiple DNS Servers
CONFIG_DNS_RESOLVER_MAX_SERVERS=3

# No Ethernet on this board
CONFIG_ETH_NXP_ENET=n
CONFIG_PHY_MICROCHIP_KSZ8081=n
CONFIG_NET_CONFIG_AUTO_INIT=n
CONFIG_NET_CONFIG_NEED_IPV4=n
```

## src/main.c
```c
/*
 * Copyright (c) 2025 Golioth, Inc.
 *
 * SPDX-License-Identifier: Apache-2.0
 */

#include <zephyr/bluetooth/bluetooth.h>
#include <zephyr/bluetooth/conn.h>
#include <zephyr/bluetooth/hci.h>
#include <zephyr/net/net_if.h>
#include <zephyr/net/net_mgmt.h>
#include <zephyr/net/dhcpv4.h>
#include <zephyr/drivers/gpio.h>

#include <pouch/pouch.h>
#include <pouch/uplink.h>
#include <pouch/transport/bluetooth/gatt.h>
#include <pouch/transport/certificate.h>
#include <pouch/transport/coap/client.h>
#include <pouch/transport/coap/gateway.h>

#include <pouch/gateway/bt/bond.h>
#include <pouch/gateway/bt/connect.h>
#include <pouch/gateway/bt/scan.h>
#include <pouch/gateway/cert.h>
#include <pouch/gateway/cloud.h>
#include <pouch/gateway/uplink.h>

#include <golioth/settings_callbacks.h>

#include "credentials.h"
#include "fw_update.h"

#if defined(CONFIG_WIFI)
#include "wifi.h"
#endif

#include <git_describe.h>
#include <app_version.h>

#include <zephyr/logging/log.h>
LOG_MODULE_REGISTER(main);

struct net_wait_data
{
    struct k_sem sem;
    struct net_mgmt_event_callback cb;
};

static const struct gpio_dt_spec button = GPIO_DT_SPEC_GET_OR(DT_ALIAS(sw0), gpios, {});
static struct gpio_callback button_cb_data;
static struct bt_conn *default_conn;

static const k_timeout_t bonding_timeout = K_SECONDS(30);
static const bt_security_t bt_security =
    IS_ENABLED(CONFIG_POUCH_GATEWAY_GATT_SCAN_FILTER_BONDED) ? BT_SECURITY_L4 : BT_SECURITY_L2;

static void button_pressed(const struct device *dev, struct gpio_callback *cb, uint32_t pins)
{
    if (default_conn)
    {
        LOG_INF("Confirming passkey");
        bt_conn_auth_passkey_confirm(default_conn);
    }
    else if (pouch_gateway_bonding_is_enabled())
    {
        LOG_WRN("Bonding already enabled");
    }
    else
    {
        pouch_gateway_bonding_enable(bonding_timeout);
    }
}

static void do_uplink(void)
{
    const char *payload = "{\"temp\":22}";
    pouch_uplink_entry_write(".s/sensor",
                             POUCH_CONTENT_TYPE_JSON,
                             payload,
                             strlen(payload),
                             POUCH_FOREVER);
}
POUCH_UPLINK_HANDLER(do_uplink);

static int led_setting_cb(bool new_value)
{
    LOG_INF("Received LED setting: %d", (int) new_value);

    return 0;
}

GOLIOTH_SETTINGS_HANDLER(LED, led_setting_cb);

static void event_cb_handler(struct net_mgmt_event_callback *cb,
                             uint64_t mgmt_event,
                             struct net_if *iface)
{
    struct net_wait_data *wait = CONTAINER_OF(cb, struct net_wait_data, cb);

    if (mgmt_event == cb->event_mask)
    {
        k_sem_give(&wait->sem);
    }
}

static void wait_for_net_event(struct net_if *iface, uint64_t event)
{
    struct net_wait_data wait;

    wait.cb.handler = event_cb_handler;
    wait.cb.event_mask = event;

    k_sem_init(&wait.sem, 0, 1);
    net_mgmt_add_event_callback(&wait.cb);

    k_sem_take(&wait.sem, K_FOREVER);

    net_mgmt_del_event_callback(&wait.cb);
}

static void wait_for_network(void)
{
    struct net_if *iface = net_if_get_default();

    if (!net_if_is_up(iface))
    {
        LOG_INF("Bringing up network interface (%p)", (void *) iface);
        int ret = net_if_up(iface);
        if ((ret < 0) && (ret != -EALREADY))
        {
            LOG_ERR("Failed to bring up network interface: %d", ret);
            return;
        }
    }

    if (IS_ENABLED(CONFIG_WIFI))
    {
        struct net_wait_data wait;

        wait.cb.handler = event_cb_handler;
        wait.cb.event_mask = NET_EVENT_IPV4_ADDR_ADD;
        k_sem_init(&wait.sem, 0, 1);
        net_mgmt_add_event_callback(&wait.cb);

        IF_ENABLED(CONFIG_WIFI, (wifi_connect()));

        if (IS_ENABLED(CONFIG_NET_DHCPV4))
        {
            net_dhcpv4_start(iface);
        }

        LOG_INF("Waiting to obtain IP address");
        k_sem_take(&wait.sem, K_FOREVER);
        net_mgmt_del_event_callback(&wait.cb);
    }
    else if (IS_ENABLED(CONFIG_NET_L2_ETHERNET) && IS_ENABLED(CONFIG_NET_DHCPV4))
    {
        net_dhcpv4_start(net_if_get_default());
    }
    else if (IS_ENABLED(CONFIG_MODEM))
    {
        LOG_INF("Waiting to obtain IP address");
        wait_for_net_event(iface,
                           IS_ENABLED(DNS_SERVER_IP_ADDRESSES) ? NET_EVENT_DNS_SERVER_ADD
                                                               : NET_EVENT_IPV4_ADDR_ADD);
    }
}

static void bt_connected(struct bt_conn *conn, uint8_t err)
{
    char addr[BT_ADDR_LE_STR_LEN];

    bt_addr_le_to_str(bt_conn_get_dst(conn), addr, sizeof(addr));

    if (err)
    {
        LOG_ERR("Failed to connect to %s %u %s", addr, err, bt_hci_err_to_str(err));

        bt_conn_unref(conn);

        pouch_gateway_scan_start();
        return;
    }

    LOG_INF("Connected: %s", addr);
    default_conn = conn;

    err = bt_conn_set_security(conn, bt_security);
    if (err)
    {
        LOG_ERR("Failed to set security (%d).", err);

        bt_conn_disconnect(conn, BT_HCI_ERR_REMOTE_USER_TERM_CONN);
        return;
    }
}

static void bt_disconnected(struct bt_conn *conn, uint8_t reason)
{
    char addr[BT_ADDR_LE_STR_LEN];

    default_conn = NULL;

    bt_addr_le_to_str(bt_conn_get_dst(conn), addr, sizeof(addr));
    LOG_INF("Disconnected: %s, reason 0x%02x %s", addr, reason, bt_hci_err_to_str(reason));

    bt_conn_unref(conn);

    pouch_gateway_scan_start();
}

static void on_gateway_end(struct bt_conn *conn)
{
    bt_conn_disconnect(conn, BT_HCI_ERR_REMOTE_USER_TERM_CONN);
}

static void security_changed(struct bt_conn *conn, bt_security_t level, enum bt_security_err err)
{
    if (err)
    {
        LOG_ERR("BT security change failed. Current level: %d, err: %s(%u)",
                level,
                bt_security_err_to_str(err),
                err);

        struct bt_conn_info info;
        bt_conn_get_info(conn, &info);

        bt_unpair(info.id, info.le.dst);
        bt_conn_disconnect(conn, BT_HCI_ERR_INSUFFICIENT_SECURITY);
    }
    else
    {
        LOG_INF("BT security changed to level %u", level);

        pouch_gateway_bt_start(conn, on_gateway_end);
    }
}

BT_CONN_CB_DEFINE(conn_callbacks) = {
    .connected = bt_connected,
    .disconnected = bt_disconnected,
    .security_changed = security_changed,
};

static void auth_cancel(struct bt_conn *conn)
{
    char addr[BT_ADDR_LE_STR_LEN];

    bt_addr_le_to_str(bt_conn_get_dst(conn), addr, sizeof(addr));

    LOG_INF("Pairing cancelled: %s", addr);
}

static void auth_passkey_confirm(struct bt_conn *conn, unsigned int passkey)
{
    char addr[BT_ADDR_LE_STR_LEN];
    char passkey_str[7];

    bt_addr_le_to_str(bt_conn_get_dst(conn), addr, sizeof(addr));

    snprintk(passkey_str, 7, "%06u", passkey);

    LOG_INF("Confirm passkey for %s: %s", addr, passkey_str);

    if (IS_ENABLED(CONFIG_SAMPLE_POUCH_GATEWAY_BT_AUTO_CONFIRM))
    {
        LOG_INF("Confirming passkey");
        bt_conn_auth_passkey_confirm(conn);
    }
}

static void auth_passkey_display(struct bt_conn *conn, unsigned int passkey)
{
    char addr[BT_ADDR_LE_STR_LEN];
    char passkey_str[7];

    bt_addr_le_to_str(bt_conn_get_dst(conn), addr, sizeof(addr));

    snprintk(passkey_str, 7, "%06u", passkey);

    LOG_INF("Passkey for %s: %s", addr, passkey_str);
}

static struct bt_conn_auth_cb auth_cb = {
    .cancel = auth_cancel,

    .passkey_confirm =
        IS_ENABLED(CONFIG_POUCH_GATEWAY_GATT_SCAN_FILTER_BONDED) ? auth_passkey_confirm : NULL,
    .passkey_display =
        IS_ENABLED(CONFIG_POUCH_GATEWAY_GATT_SCAN_FILTER_BONDED) ? auth_passkey_display : NULL,
};

static void pairing_complete(struct bt_conn *conn, bool bonded)
{
    LOG_INF("Pairing Complete");
}

static void pairing_failed(struct bt_conn *conn, enum bt_security_err reason)
{
    LOG_WRN("Pairing Failed (%d). Disconnecting.", reason);

    bt_conn_disconnect(conn,
                       (reason == BT_SECURITY_ERR_PAIR_NOT_ALLOWED) ? BT_HCI_ERR_PAIRING_NOT_ALLOWED
                                                                    : BT_HCI_ERR_AUTH_FAIL);
}

static struct bt_conn_auth_info_cb auth_info_cb = {
    .pairing_complete = pairing_complete,
    .pairing_failed = pairing_failed,
};

int main(void)
{
    int err;

    LOG_INF("Gateway Version: " STRINGIFY(GIT_DESCRIBE));
    LOG_INF("Gateway app version (MCUboot / Golioth package): " APP_VERSION_STRING);
    LOG_INF("Pouch BLE Transport Protocol Version: %d", POUCH_GATT_VERSION);

    /* Load the Pouch device's identity (cert + key). */
    struct pouch_config config = {0};

    err = load_certificate(&config.certificate);
    if (err)
    {
        LOG_ERR("Failed to load certificate (err %d)", err);
        return 0;
    }

    config.private_key = load_private_key();
    if (config.private_key == PSA_KEY_ID_NULL)
    {
        LOG_ERR("Failed to load private key");
        return 0;
    }

    LOG_INF("Credentials loaded");

    err = pouch_init(&config);
    if (err)
    {
        LOG_ERR("Pouch init failed (err %d)", err);
        return 0;
    }

    /* Load DTLS credentials for the CoAP transport. */
    if (IS_ENABLED(CONFIG_POUCH_GATEWAY_CLOUD))
    {
        err = load_coap_server_ca(CONFIG_EXAMPLE_COAP_CLIENT_DTLS_CREDENTIALS);
        if (err)
        {
            LOG_ERR("Failed to load server CA certificate (err %d)", err);
            return 0;
        }

        err = load_coap_gw_device_crt(CONFIG_EXAMPLE_COAP_CLIENT_DTLS_CREDENTIALS);
        if (err)
        {
            LOG_ERR("Failed to load device certificate (err %d)", err);
            return 0;
        }

        err = load_coap_gw_device_key(CONFIG_EXAMPLE_COAP_CLIENT_DTLS_CREDENTIALS);
        if (err)
        {
            LOG_ERR("Failed to load device key (err %d)", err);
            return 0;
        }

        err = pouch_coap_client_init(CONFIG_EXAMPLE_COAP_CLIENT_DTLS_CREDENTIALS);
        if (err)
        {
            LOG_ERR("Failed to initialize CoAP client transport: %d", err);
            return err;
        }

        pouch_coap_gateway_init();
    }

    if (DT_HAS_ALIAS(sw0))
    {
        LOG_INF("Set up button at %s pin %d", button.port->name, button.pin);

        err = gpio_pin_configure_dt(&button, GPIO_INPUT);
        if (err < 0)
        {
            LOG_ERR("Could not initialize Button");
        }

        err = gpio_pin_interrupt_configure_dt(&button, GPIO_INT_EDGE_TO_ACTIVE);
        if (err)
        {
            LOG_ERR("Error %d: failed to configure interrupt on %s pin %d",
                    err,
                    button.port->name,
                    button.pin);
            return 0;
        }

        gpio_init_callback(&button_cb_data, button_pressed, BIT(button.pin));
        gpio_add_callback(button.port, &button_cb_data);
    }

    /* Wait for network and prime the cloud transport so the server
     * certificate is available before any BLE peripheral connects.
     */
    if (IS_ENABLED(CONFIG_POUCH_GATEWAY_CLOUD))
    {
        wait_for_network();

        while (true)
        {
            err = pouch_gateway_cloud_ensure_ready();
            if (!err)
            {
                break;
            }
            LOG_WRN("Initial cloud transport setup failed: %d, will retry", err);
            k_sleep(K_SECONDS(5));
        }
    }

    pouch_gateway_cert_module_init();
    pouch_gateway_uplink_module_init();

    err = bt_enable(NULL);
    if (err)
    {
        LOG_ERR("Bluetooth init failed (err %d)", err);
        return err;
    }

    if (IS_ENABLED(CONFIG_BT_SMP))
    {
        bt_conn_auth_cb_register(&auth_cb);
        bt_conn_auth_info_cb_register(&auth_info_cb);
    }

    LOG_INF("Bluetooth initialized");

    if (IS_ENABLED(CONFIG_SAMPLE_POUCH_GATEWAY_BT_AUTO_BOND))
    {
        pouch_gateway_bonding_enable(K_FOREVER);
    }

    pouch_gateway_scan_start();

    /* Health check before confirming an OTA image (MCUboot test mode):
     *  - Wi-Fi up and IP address (wait_for_network() above),
     *  - cloud transport ready (pouch_gateway_cloud_ensure_ready() above),
     *  - Bluetooth enabled and scanning (just now),
     *  - and, below, one successful Pouch sync with Golioth on this image.
     * Without the cloud there is nothing more to wait for. If any step never happens the image
     * stays unconfirmed and MCUboot reverts to the old one at the next reset.
     */
    if (!IS_ENABLED(CONFIG_POUCH_GATEWAY_CLOUD))
    {
        fw_update_confirm_healthy();
    }

    if (IS_ENABLED(CONFIG_POUCH_GATEWAY_CLOUD))
    {
        while (true)
        {
            k_sleep(K_SECONDS(CONFIG_EXAMPLE_COAP_CLIENT_SYNC_PERIOD_S));

            err = pouch_coap_client_sync();
            if (err)
            {
                LOG_WRN("CoAP sync failed: %d", err);
            }
            else
            {
                fw_update_confirm_healthy();
            }
        }
    }

    return 0;
}
```

## src/fw_update.c
```c
/*
 * Copyright (c) 2026 Golioth, Inc.
 *
 * SPDX-License-Identifier: Apache-2.0
 *
 * Based on golioth/pouch examples/zephyr/coap_client/src/fw_update.c at 32ded9b. Changes:
 *  - the upgrade is requested in TEST mode (BOOT_UPGRADE_TEST), not PERMANENT, so MCUboot
 *    reverts to the old image on the next reset unless the new one confirms itself;
 *  - fw_update_confirm_healthy() confirms the image, and main.c only calls it after the health
 *    check (Wi-Fi up, Golioth sync ok, BLE scanning);
 *  - no download is started while the running image is still unconfirmed.
 */

#include <zephyr/logging/log.h>
LOG_MODULE_REGISTER(fw_update);

#include <zephyr/kernel.h>
#include <zephyr/dfu/flash_img.h>
#include <zephyr/dfu/mcuboot.h>
#include <zephyr/logging/log_ctrl.h>
#include <zephyr/storage/flash_map.h>
#include <zephyr/sys/reboot.h>

#include <golioth/ota.h>

#include <app_version.h>

#include "fw_update.h"

static struct flash_img_context flash_context;

void fw_update_confirm_healthy(void)
{
    if (boot_is_img_confirmed())
    {
        return;
    }

    int err = boot_write_img_confirmed();

    if (err)
    {
        LOG_ERR("Failed to confirm the running image: %d", err);
        return;
    }

    LOG_INF("Image confirmed (version " APP_VERSION_STRING ")");
}

static void ota_fw_receive(const void *data, size_t offset, size_t len, bool is_last)
{
    LOG_DBG("Received %d bytes at offset %d", len, offset);

    int err = 0;

    if (0 == offset)
    {
        err = flash_img_init(&flash_context);
        if (err)
        {
            LOG_ERR("Failed to init flash write");
            return;
        }
    }

    err = flash_img_buffered_write(&flash_context, data, len, is_last);
    if (err)
    {
        LOG_ERR("Failed to write to flash: %d", err);
        return;
    }

    if (is_last)
    {
        /* Test mode: MCUboot boots the new image once and reverts at the next reset unless the
         * new image calls boot_write_img_confirmed().
         */
        err = boot_request_upgrade(BOOT_UPGRADE_TEST);
        if (err)
        {
            LOG_ERR("Failed to request upgrade");
            return;
        }

        LOG_INF("Rebooting to apply upgrade");

#if IS_ENABLED(CONFIG_LOG)
        while (log_process())
        {
        }
#endif

        k_sleep(K_SECONDS(3));

        sys_reboot(SYS_REBOOT_WARM);
    }
}

static void ota_manifest_receive(const struct golioth_ota_manifest_component *components,
                                 size_t num_components)
{
    for (int i = 0; i < num_components; i++)
    {
        LOG_DBG("Target: %s@%s, %d bytes",
                components[i].name,
                components[i].target,
                components[i].size);
        LOG_HEXDUMP_DBG(components[i].target_hash,
                        GOLIOTH_OTA_COMPONENT_HASH_BIN_LEN,
                        "Target hash:");
        if (0 != strcmp(components[i].current, components[i].target))
        {
            if (!boot_is_img_confirmed())
            {
                /* A new upgrade request on top of an unconfirmed image would make MCUboot
                 * revert the running image first. Wait for the health check.
                 */
                LOG_WRN("Update to %s postponed: running image not confirmed yet",
                        components[i].target);
                continue;
            }
            golioth_ota_mark_for_download(components[i].name);
        }
    }
}

GOLIOTH_OTA_COMPONENT(fw, CONFIG_EXAMPLE_FW_UPDATE_COMPONENT, APP_VERSION_STRING, ota_fw_receive);
GOLIOTH_OTA_MANIFEST_HANDLER(ota_manifest_receive);
```

## src/fw_update.h
```c
/*
 * Gateway firmware update (Golioth OTA through Pouch's golioth_sdk) and MCUboot image confirm.
 *
 * SPDX-License-Identifier: Apache-2.0
 */

#pragma once

/**
 * Confirm the running MCUboot image if it is still in test mode (first boot after an OTA).
 *
 * Call this only after the gateway has proven itself healthy. Does nothing if the image is
 * already confirmed (normal boots, and images flashed directly).
 */
void fw_update_confirm_healthy(void);
```
