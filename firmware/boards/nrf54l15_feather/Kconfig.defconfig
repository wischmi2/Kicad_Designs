## firmware/boards/nrf54l15_feather/Kconfig.defconfig
```kconfig
if BOARD_NRF54L15_FEATHER

config HW_STACK_PROTECTION
	default ARCH_HAS_STACK_PROTECTION

endif # BOARD_NRF54L15_FEATHER
```

## firmware/boards/nrf54l15_feather/Kconfig.nrf54l15_feather
```kconfig
config BOARD_NRF54L15_FEATHER
	select SOC_NRF54L15_CPUAPP if BOARD_NRF54L15_FEATHER_NRF54L15_CPUAPP
```

## firmware/boards/nrf54l15_feather/board.yml
```yaml
board:
  name: nrf54l15_feather
  full_name: nRF54L15 Feather
  vendor: others
  socs:
    - name: nrf54l15
runners:
  run_once:
    '--recover':
      - runners:
          - nrfjprog
          - nrfutil
        run: first
        groups:
          - boards:
              - nrf54l15_feather/nrf54l15/cpuapp
    '--erase':
      - runners:
          - nrfjprog
          - jlink
          - nrfutil
        run: first
        groups:
          - boards:
              - nrf54l15_feather/nrf54l15/cpuapp
    '--reset':
      - runners:
          - nrfjprog
          - jlink
          - nrfutil
        run: last
        groups:
          - boards:
              - nrf54l15_feather/nrf54l15/cpuapp
```

## firmware/boards/pouch_gateway/board.yml
```yaml
board:
  name: pouch_gateway
  full_name: Pouch gateway (Murata Type 2FR, NXP RW612)
  vendor: others
  socs:
    - name: rw612
```
